## app/boards/shields/atreus_choc/Kconfig.defconfig
```kconfig
# Copyright (c) 2021 The ZMK Contributors
# SPDX-License-Identifier: MIT

if SHIELD_ATREUS_CHOC

config ZMK_KEYBOARD_NAME
    default "Atreus"

endif
```
